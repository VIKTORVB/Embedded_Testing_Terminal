/*
 * File:   DIsplay.c
 * Author: Victorious
 *
 * Created on 31 March 2021, 21:41
 */


#include <xc.h>
#include "Display.h"


const uint8_t Character_map[95][5] ={
    0x00, 0x00, 0x00, 0x00, 0x00, // space
    0x00, 0x00, 0x2f, 0x00, 0x00, // !
    0x00, 0x07, 0x00, 0x07, 0x00, // "
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    0x00, 0x06, 0x09, 0x09, 0x06 // ~ 
};

void GLCD_Initialise()
{
    /* Select the Page0/Page1 and Turn on the GLCD */
    Select_Page(0);
    Command_Write(0x3f);
    Select_Page(1);
    Command_Write(0x3f);
    __delay_us(2);

    /* Select the Page0/Page1 and Enable the GLCD */
    Select_Page(0);
    Command_Write(0xc0);
    Select_Page(1);
    Command_Write(0xc0);
    __delay_us(2);
}

void Select_Page(int select) // CS1=1, CS2=0
{
    if (select == 1) { // if received a 1 set the page select pins to page one
        CS1 = 0;
        __delay_us(2); // delay for a short period to ensure pins have been set
        CS2 = 1;
        __delay_us(2);
    } else { // else set the page select pins to page zero
        CS1 = 1;
        __delay_us(2);
        CS2 = 0;
        __delay_us(2);
    }
}

/* Function to send the command to LCD */
void Command_Write(char cmd) {
    GlcdDataBus = cmd; //Send the Command nibble
    RS = 0; // Send LOW pulse on RS pin for selecting Command register
    RW = 0; // Send LOW pulse on RW pin for Write operation
    EN = 1; // Generate a High-to-low pulse on EN pin
    __delay_us(2);
    EN = 0;
    __delay_us(20);
    ;
}

/* Function to send the Data to LCD */
void Data_Write(char dat) {
    GlcdDataBus = dat; //Send the data on DataBus nibble
    RS = 1; // Send HIGH pulse on RS pin for selecting data register
    RW = 0; // Send LOW pulse on RW pin for Write operation
    EN = 1; // Generate a High-to-low pulse on EN pin
    __delay_us(2);
    EN = 0;
    __delay_us(20);
}

void Display_Character(char ASCII) {
    char dat;
    ASCII = ASCII - 32; // Since the array dose not use the command ASCII characters it starts from 32 
    for (int i = 0; i < 5; i++) // 5x7 font, 5 chars 
    {
        dat = Character_map[ASCII][i]; // get the data from the array and send it to the write function

        Data_Write(dat);
    }
}

void Display_Message(char message[]) {
    char data;
    for (int i = 0; i < strlen(message); i++) { // loop trough the message and send the characters one by one to the screen
        data = message[i];
        Display_Character(data);
    }
}

void Clear_Display() {
    uint8_t line, cursor;

    for (line = 0; line < 8; line++) /* loop through all the 8lines to clear the display */ {
        Select_Page(0); /* Select page0 and set the cursor to first position */
        Command_Write(0x40);
        Command_Write(0xB8 + line);
        for (cursor = 0; cursor < 128; cursor++) /* Clear all the 128 pixels of selected line */ {
            if (cursor == 64) /* Has the cursor reached end of page0 */ {
                Select_Page(1); /*  then set it to beginning of page1 */
                Command_Write(0x40);
                Command_Write(0xB8 + line);
            }
            Data_Write(0x00); /* Clear each pixel by displaying blank */
        }
    }
}
